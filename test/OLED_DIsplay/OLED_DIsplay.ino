#include <SPI.h>
#include <Wire.h>
#include <Adafruit_GFX.h>
#include <Adafruit_SSD1306.h>
#include "RTClib.h"
#include "DHT.h"

#define OLED_RESET 4
Adafruit_SSD1306 display(OLED_RESET);

#define DHTPIN 2     // what digital pin we're connected to
#define DHTTYPE DHT11   // DHT 11
DHT dhtSensor(DHTPIN, DHTTYPE);

static const unsigned char PROGMEM logo[] = {
0x00, 0x00, 0x00, 0x00, 0x3F, 0xFF, 0xFF, 0xFF, 0xFF, 0xFF, 0xF0, 0x00, 0x00, 0x00, 0x00, 0x00,
0x00, 0x00, 0x00, 0x00, 0xFF, 0xFF, 0xFF, 0xFF, 0xFF, 0xFF, 0xF8, 0x00, 0x00, 0x00, 0x00, 0x00,
0x00, 0x00, 0x00, 0x01, 0xFF, 0xFF, 0xFF, 0xFF, 0xFF, 0xFF, 0xFC, 0x00, 0x00, 0x00, 0x00, 0x00,
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0x00, 0x00, 0x00, 0x00, 0x7F, 0xFF, 0xFF, 0xFF, 0xFF, 0xFF, 0xF0, 0x00, 0x00, 0x00, 0x00, 0x00
};
  
static const unsigned char PROGMEM image[] = {
0xFD, 0xFF, 0xFF, 0x73, 0xFF, 0x80, 0x00, 0x00, 0x00, 0x00, 0x00, 0x03, 0xBF, 0xFF, 0x00, 0x00,
0xFF, 0xFF, 0xFF, 0xFF, 0xBF, 0x68, 0x00, 0x00, 0x00, 0x00, 0x00, 0x01, 0xFF, 0xFF, 0x80, 0x00,
0xFF, 0xF3, 0xFE, 0xFF, 0xF9, 0x3A, 0x00, 0x00, 0x00, 0x00, 0x00, 0x03, 0xFF, 0xFF, 0xE0, 0x00,
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0xFF, 0xFF, 0xFF, 0xFF, 0x87, 0xB0, 0x01, 0x00, 0x00, 0x00, 0xFF, 0xFF, 0xFC, 0x64, 0x00, 0x00
};

static const unsigned char PROGMEM messageIcon [] = {
0x00, 0x00, 0x00, 0x3F, 0xFF, 0xF8, 0x7F, 0xFF, 0xF8, 0x70, 0x00, 0x18, 0x7C, 0x00, 0x78, 0x6E,
0x01, 0xEC, 0x63, 0x83, 0x8C, 0x60, 0xEE, 0x0C, 0x60, 0x78, 0x0C, 0x60, 0x10, 0x0C, 0x60, 0x00,
0x0C, 0x60, 0x00, 0x0C, 0x60, 0x00, 0x0C, 0x60, 0x00, 0x0C, 0x3F, 0xFF, 0xF8, 0x00, 0x00, 0x00
};

RTC_DS1307 rtc;
long clockSecondCounter = -1;
long hourL = 0;
void setup()
{
  display.begin(SSD1306_SWITCHCAPVCC, 0x3C);
  display.clearDisplay();

  Serial.begin(9600);
  if (! rtc.begin())
  {
    Serial.println("Couldn't find RTC");
    while (1);
  }
  
//  drawImage(0, 0, messageIcon, 22, 16);
//  delay(2000);
//  display.clearDisplay();

  drawAgentNames("ABC", "A1", "A2", "A3", "A4");
  displayTemp(20, 5);
  displayHumidity(54, 6);
  
  DateTime now = rtc.now();
  clockSecondCounter = ( now.hour() * 3600L ) + (now.minute() * 60) + now.second();
  
  dhtSensor.begin();
}

void loop()
{
  DateTime now = rtc.now();
  clockSecondCounter = ( now.hour() * 3600L ) + (now.minute() * 60) + now.second();
  displayTime( clockSecondCounter );
  
  // Request temp and humidity with 2 second cyle
  if ( clockSecondCounter % 2 == 0 )
  {
    unsigned int temp = readTemperature();
    displayTemp(temp / 10, temp % 10);
    
    unsigned int humidity = readHumidity();
    displayHumidity(humidity / 10, humidity % 10);
    
  Serial.print("Humidity: ");
  Serial.print(humidity);
  Serial.print(" %\t");
  Serial.print("Temperature: ");
  Serial.print(temp);
  Serial.println(" *C ");
  }
  
  delay( 200 );
}

void drawImage(int16_t x, int16_t y, const uint8_t *image, int16_t w, int16_t h)
{
  display.clearDisplay();
  int16_t i;
  for (i = 0; i < h; i ++ )
  {
    int16_t j;
    for (j = 0; j < w; j ++ )
    {
      //https://www.arduino.cc/en/Reference/PROGMEM
      uint8_t value = pgm_read_byte(image + i * w / 8 + j / 8);
      if ( bitRead(value,7 - (j % 8)))
      {
        display.drawPixel(j + x, i + y, WHITE);
      }
    }
  }
  display.display();  
}

// Display agent name and connected agent names
void drawAgentNames(String agentName, String a1, String a2, String a3, String a4)
{
  display.setTextSize(1);
  
  // Display agent name
  display.fillRoundRect(48, 0, 32, 16, 2, WHITE);
  display.setTextColor(BLACK);
  display.setCursor(56,5);
  display.println(agentName);
  
  // Display connected agent names
  display.setTextColor(WHITE);
  display.drawRoundRect(0, 0, 22, 16, 2, WHITE);
  display.setCursor(6,5);
  display.println(a3);
  
  display.drawRoundRect(24, 0, 22, 16, 2, WHITE);
  display.setCursor(30,5);
  display.println(a1);
  
  display.drawRoundRect(82, 0, 22, 16, 2, WHITE);
  display.setCursor(88,5);
  display.println(a2);
  
  display.drawRoundRect(106, 0, 22, 16, 2, WHITE);
  display.setCursor(112,5);
  display.println(a4);
  
  display.drawRect(0, 17, 128, 47, WHITE);
  display.display();
}

// Display time based on the given seconds value
void displayTime(long seconds)
{
  uint8_t x = 78;
  uint8_t y = 54;
 
  // Draw bounding rectangle
  display.fillRect(x - 2, y - 2, 51, 11, WHITE);
  display.setTextColor(BLACK);
  display.setTextSize(1);
    
  if ( seconds == -1 ) // indicate that time is not set
  {
    display.setCursor(x,y);
    display.println("! No RTC");
  }
  else
  {
    uint8_t sec = (seconds % 3600) % 60;
    uint8_t mint = (seconds % 3600) / 60;
    uint8_t hour = seconds / 3600;
    
    // Display H
  
    display.setCursor(x,y);
    if ( hour < 10 )
    {
      display.println("0" + String(hour));
    }
    else
    {
      display.println(hour);
    }
    display.setCursor(x + 12,y);
    display.println(":");
    
    // Display M
    display.setCursor(x + 17,y);
    if ( mint < 10 )
    {
      display.println("0" + String(mint));
    }
    else
    {
      display.println(mint);
    }
    display.setCursor(x + 29,y);
    display.println(":");
    
    // Display S
    display.setCursor(x + 34,y);
    if ( sec < 10 )
    {
      display.println("0" + String(sec));
    }
    else
    {
      display.println(sec);
    }
  }
  display.display();
}

void displayTemp(uint8_t intValue, uint8_t factValue)
{
  uint8_t x = 22;
  uint8_t y = 22;
  
  display.setTextColor(WHITE);
  display.setTextSize(1);  
  display.setCursor(x - 20,y);
  display.println("TMP"); 
  
  // clear previous value
  display.fillRect(x, y, 35, 16, BLACK);
  
  displayDigit(x, y, intValue / 10);
  displayDigit(x + 12, y, intValue % 10);
  displayDot(x + 23, y + 14);
  displayDigit(x + 26, y, factValue); 

  displayDot(x + 37, y);
  display.setTextColor(WHITE);
  display.setTextSize(2);  
  display.setCursor(x + 40,y);
  display.println("C");
}

void displayHumidity(uint8_t intValue, uint8_t factValue)
{
  uint8_t x = 22;
  uint8_t y = 42;

  display.setTextColor(WHITE);
  display.setTextSize(1);  
  display.setCursor(x - 20,y);
  display.println("RHM"); 
  
  // clear previous value
  display.fillRect(x, y, 35, 16, BLACK);
  
  displayDigit(x, y, intValue / 10);
  displayDigit(x + 12, y, intValue % 10);
  displayDot(x + 23, y + 14);
  displayDigit(x + 26, y, factValue); 

  display.setTextColor(WHITE);
  display.setTextSize(2);  
  display.setCursor(x + 40,y);
  display.println("%");  
}

void displayDigit(uint8_t x, uint8_t y, uint8_t digit)
{
  switch ( digit )
  {
    case 0 :
    {
      display.drawRect(x + 2, y, 5, 2, WHITE);
      //display.drawRect(x + 2, y + 7, 5, 2, WHITE);
      display.drawRect(x + 2, y + 14, 5, 2, WHITE);
  
      display.drawRect(x, y + 2, 2, 5, WHITE);
      display.drawRect(x + 7, y + 2, 2, 5, WHITE);
      display.drawRect(x, y + 9, 2, 5, WHITE);
      display.drawRect(x + 7, y + 9, 2, 5, WHITE);
    } break;
	case 1 :
    {
      //display.drawRect(x + 2, y, 5, 2, WHITE);
      //display.drawRect(x + 2, y + 7, 5, 2, WHITE);
      //display.drawRect(x + 2, y + 14, 5, 2, WHITE);
  
      //display.drawRect(x, y + 2, 2, 5, WHITE);
      display.drawRect(x + 7, y + 2, 2, 5, WHITE);
      //display.drawRect(x, y + 9, 2, 5, WHITE);
      display.drawRect(x + 7, y + 9, 2, 5, WHITE);
    } break;
	case 2 :
    {
      display.drawRect(x + 2, y, 5, 2, WHITE);
      display.drawRect(x + 2, y + 7, 5, 2, WHITE);
      display.drawRect(x + 2, y + 14, 5, 2, WHITE);
  
      //display.drawRect(x, y + 2, 2, 5, WHITE);
      display.drawRect(x + 7, y + 2, 2, 5, WHITE);
      display.drawRect(x, y + 9, 2, 5, WHITE);
      //display.drawRect(x + 7, y + 9, 2, 5, WHITE);
    } break;
	case 3 :
    {
      display.drawRect(x + 2, y, 5, 2, WHITE);
      display.drawRect(x + 2, y + 7, 5, 2, WHITE);
      display.drawRect(x + 2, y + 14, 5, 2, WHITE);
  
      //display.drawRect(x, y + 2, 2, 5, WHITE);
      display.drawRect(x + 7, y + 2, 2, 5, WHITE);
      //display.drawRect(x, y + 9, 2, 5, WHITE);
      display.drawRect(x + 7, y + 9, 2, 5, WHITE);
    } break;
	case 4 :
    {
      //display.drawRect(x + 2, y, 5, 2, WHITE);
      display.drawRect(x + 2, y + 7, 5, 2, WHITE);
      //display.drawRect(x + 2, y + 14, 5, 2, WHITE);
  
      display.drawRect(x, y + 2, 2, 5, WHITE);
      display.drawRect(x + 7, y + 2, 2, 5, WHITE);
      //display.drawRect(x, y + 9, 2, 5, WHITE);
      display.drawRect(x + 7, y + 9, 2, 5, WHITE);
    } break;
	case 5 :
    {
      display.drawRect(x + 2, y, 5, 2, WHITE);
      display.drawRect(x + 2, y + 7, 5, 2, WHITE);
      display.drawRect(x + 2, y + 14, 5, 2, WHITE);
  
      display.drawRect(x, y + 2, 2, 5, WHITE);
      //display.drawRect(x + 7, y + 2, 2, 5, WHITE);
      //display.drawRect(x, y + 9, 2, 5, WHITE);
      display.drawRect(x + 7, y + 9, 2, 5, WHITE);
    } break;
	case 6 :
    {
      display.drawRect(x + 2, y, 5, 2, WHITE);
      display.drawRect(x + 2, y + 7, 5, 2, WHITE);
      display.drawRect(x + 2, y + 14, 5, 2, WHITE);
  
      display.drawRect(x, y + 2, 2, 5, WHITE);
      //display.drawRect(x + 7, y + 2, 2, 5, WHITE);
      display.drawRect(x, y + 9, 2, 5, WHITE);
      display.drawRect(x + 7, y + 9, 2, 5, WHITE);
    } break;
	case 7 :
    {
      display.drawRect(x + 2, y, 5, 2, WHITE);
      //display.drawRect(x + 2, y + 7, 5, 2, WHITE);
      //display.drawRect(x + 2, y + 14, 5, 2, WHITE);
  
      //display.drawRect(x, y + 2, 2, 5, WHITE);
      display.drawRect(x + 7, y + 2, 2, 5, WHITE);
      //display.drawRect(x, y + 9, 2, 5, WHITE);
      display.drawRect(x + 7, y + 9, 2, 5, WHITE);
    } break;
	case 8 :
    {
      display.drawRect(x + 2, y, 5, 2, WHITE);
      display.drawRect(x + 2, y + 7, 5, 2, WHITE);
      display.drawRect(x + 2, y + 14, 5, 2, WHITE);
  
      display.drawRect(x, y + 2, 2, 5, WHITE);
      display.drawRect(x + 7, y + 2, 2, 5, WHITE);
      display.drawRect(x, y + 9, 2, 5, WHITE);
      display.drawRect(x + 7, y + 9, 2, 5, WHITE);
    } break;
	case 9 :
    {
      display.drawRect(x + 2, y, 5, 2, WHITE);
      display.drawRect(x + 2, y + 7, 5, 2, WHITE);
      display.drawRect(x + 2, y + 14, 5, 2, WHITE);
  
      display.drawRect(x, y + 2, 2, 5, WHITE);
      display.drawRect(x + 7, y + 2, 2, 5, WHITE);
      //display.drawRect(x, y + 9, 2, 5, WHITE);
      display.drawRect(x + 7, y + 9, 2, 5, WHITE);
    } break;
  }
}

void displayDot(uint8_t x, uint8_t y)
{
  display.drawRect(x, y, 2, 2, WHITE);
}

unsigned int readHumidity()
{
  float h = dhtSensor.readHumidity();
  if ( !isnan( h ) )
  {
    return h * 10;
  }
  
  return 0;
}

unsigned int readTemperature()
{
  float t = dhtSensor.readTemperature();
  if ( !isnan( t ) )
  {
    return t * 10;
  }
  
  return 0;
}


